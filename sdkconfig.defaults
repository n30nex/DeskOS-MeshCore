## sdkconfig.defaults
```kconfig
# MeshCore DeskOS D1L defaults.
# The pinned Seeed v1.1.0 BSP/examples target ESP-IDF v5.1.x. Issue #63 selects
# ESP-IDF v5.5.4 for migration; this configuration remains subject to the
# Actions build and exact COM12 qualification documented in the release plan.
CONFIG_IDF_TARGET="esp32s3"
CONFIG_IDF_EXPERIMENTAL_FEATURES=y
# Keep exact-source Actions rebuilds byte-identical across build time and
# checkout paths. The pinned ESP-IDF image fixes the remaining build tools.
CONFIG_APP_REPRODUCIBLE_BUILD=y

CONFIG_ESPTOOLPY_FLASHMODE_QIO=y
CONFIG_ESPTOOLPY_FLASHFREQ_120M=y
CONFIG_ESPTOOLPY_FLASHSIZE_8MB=y
CONFIG_PARTITION_TABLE_CUSTOM=y
CONFIG_PARTITION_TABLE_CUSTOM_FILENAME="partitions_d1l.csv"
CONFIG_PARTITION_TABLE_FILENAME="partitions_d1l.csv"

CONFIG_LCD_BOARD_SENSECAP_INDICATOR_D1L=y
CONFIG_SENSECAP_INDICATOR_SCREEN_GX=y
# CONFIG_SENSECAP_INDICATOR_SCREEN_DX is not set
CONFIG_LCD_EVB_SCREEN_ROTATION_0=y
# Use Seeed's double-framebuffer/direct-mode RGB path. The D1L panel scans
# continuously, so small strip flushes can show split/stale columns on hardware.
CONFIG_LCD_AVOID_TEAR=y
CONFIG_LCD_LVGL_DIRECT_MODE=y
CONFIG_LCD_TASK_REFRESH_TIME=10
CONFIG_LV_COLOR_DEPTH_16=y
CONFIG_LV_FONT_MONTSERRAT_14=y
CONFIG_LV_FONT_MONTSERRAT_24=y
CONFIG_LV_USE_QRCODE=y
# The production shell creates enough labels/sheets that LVGL's fixed 32 KB
# object heap can panic before the app console starts. Use the ESP-IDF heap
# allocator, matching Seeed's heavier LVGL examples.
CONFIG_LV_MEM_CUSTOM=y

# The serial console runs on app_main and can perform SD-backed retained-store
# writes during validation, so keep explicit stack headroom for those commands.
CONFIG_ESP_MAIN_TASK_STACK_SIZE=8192

CONFIG_SPIRAM=y
CONFIG_SPIRAM_MODE_OCT=y
CONFIG_SPIRAM_FETCH_INSTRUCTIONS=y
CONFIG_SPIRAM_RODATA=y
CONFIG_SPIRAM_SPEED_120M=y
# Keep ordinary UI/network allocations out of the small internal/DMA pool.
# Wi-Fi DMA buffers and FreeRTOS task stacks still use the explicitly reserved
# internal pool below.
CONFIG_SPIRAM_USE_MALLOC=y
CONFIG_SPIRAM_MALLOC_ALWAYSINTERNAL=1024
CONFIG_SPIRAM_TRY_ALLOCATE_WIFI_LWIP=y
CONFIG_SPIRAM_MALLOC_RESERVE_INTERNAL=65536
CONFIG_SPIRAM_ALLOW_BSS_SEG_EXTERNAL_MEMORY=y

CONFIG_COMPILER_OPTIMIZATION_SIZE=y
CONFIG_FREERTOS_HZ=1000
CONFIG_ESP_TASK_WDT_EN=y
CONFIG_ESP_TASK_WDT_INIT=y
# CONFIG_ESP_TASK_WDT_PANIC is not set
CONFIG_ESP_TASK_WDT_TIMEOUT_S=5
CONFIG_ESP_TASK_WDT_CHECK_IDLE_TASK_CPU0=y
# CONFIG_ESP_TASK_WDT_CHECK_IDLE_TASK_CPU1 is not set

# Build Wi-Fi support for explicit user-enabled setup and map tile downloads.
# Runtime Wi-Fi remains off by default in DeskOS settings.
CONFIG_ESP_WIFI_ENABLED=y
# Tile downloads are bounded and sequential, so use Espressif's low-memory
# buffer profile instead of reserving the high-throughput defaults.
CONFIG_ESP_WIFI_STATIC_RX_BUFFER_NUM=6
CONFIG_ESP_WIFI_DYNAMIC_RX_BUFFER_NUM=32
CONFIG_ESP_WIFI_STATIC_TX_BUFFER=y
# CONFIG_ESP_WIFI_DYNAMIC_TX_BUFFER is not set
CONFIG_ESP_WIFI_STATIC_TX_BUFFER_NUM=6
CONFIG_ESP_WIFI_RX_BA_WIN=6
# CONFIG_ESP_WIFI_IRAM_OPT is not set
# CONFIG_ESP_WIFI_RX_IRAM_OPT is not set

# Compile the low-memory BLE-only NimBLE peripheral foundation. Runtime intent
# remains off by default in settings, and Wi-Fi/BLE mode switching remains
# explicit until exact-device coexistence and memory evidence exists.
CONFIG_BT_ENABLED=y
CONFIG_BT_NIMBLE_ENABLED=y
CONFIG_BT_NIMBLE_ROLE_PERIPHERAL=y
CONFIG_BT_NIMBLE_ROLE_BROADCASTER=y
# CONFIG_BT_NIMBLE_ROLE_CENTRAL is not set
# CONFIG_BT_NIMBLE_ROLE_OBSERVER is not set
CONFIG_BT_NIMBLE_GATT_SERVER=y
# CONFIG_BT_NIMBLE_GATT_CLIENT is not set
CONFIG_BT_NIMBLE_GAP_SERVICE=y
CONFIG_BT_NIMBLE_SECURITY_ENABLE=y
# CONFIG_BT_NIMBLE_SM_LEGACY is not set
CONFIG_BT_NIMBLE_SM_SC=y
CONFIG_BT_NIMBLE_SM_SC_ONLY=y
CONFIG_BT_NIMBLE_STATIC_PASSKEY=y
CONFIG_BT_NIMBLE_NVS_PERSIST=y
CONFIG_BT_NIMBLE_MAX_BONDS=2
CONFIG_BT_NIMBLE_MAX_CONNECTIONS=1
CONFIG_BT_NIMBLE_ATT_PREFERRED_MTU=517
CONFIG_BT_NIMBLE_HOST_TASK_STACK_SIZE=4096
CONFIG_BT_NIMBLE_MSYS_1_BLOCK_COUNT=12
CONFIG_BT_NIMBLE_MSYS_2_BLOCK_COUNT=12
CONFIG_ESP_HTTP_CLIENT_ENABLE_HTTPS=y
CONFIG_LWIP_SNTP_MAX_SERVERS=1
CONFIG_MBEDTLS_CERTIFICATE_BUNDLE=y
CONFIG_MBEDTLS_CERTIFICATE_BUNDLE_DEFAULT_FULL=y
CONFIG_MBEDTLS_HAVE_TIME_DATE=y
```
